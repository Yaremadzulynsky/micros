## src/firmware/controller/Kconfig
```kconfig
menu "micros remote service management"
config MICROS_REMOTE_ENABLED
    bool "Enable authenticated HTTPS service management"
    default n
config MICROS_MANAGEMENT_TOKEN
    string "Physically provisioned 256-bit token (64 hex characters)"
    default ""
    depends on MICROS_REMOTE_ENABLED
config MICROS_RELAY_ENABLED
    bool "Enable outbound management server connection"
    default n
    depends on MICROS_REMOTE_ENABLED
config MICROS_RELAY_URL
    string "HTTPS management server origin"
    default ""
    depends on MICROS_RELAY_ENABLED
config MICROS_RELAY_TOKEN
    string "Private device enrollment token"
    default ""
    depends on MICROS_RELAY_ENABLED
endmenu
```

## src/firmware/platforms/esp32/sdk/main/Kconfig.projbuild
```kconfig
rsource "../../../../controller/Kconfig"

config MICROS_BASE_OTA
    bool "Compact A/B base updates over existing management transport"
    depends on MICROS_REMOTE_ENABLED
    select BOOTLOADER_APP_ROLLBACK_ENABLE
    default n
    help
        Requires the generated OTA partition layout installed over USB. Only the base is
        rolled back. Application storage is shared. No factory recovery image.

menu "MicroS service memory"
config MICROS_SERVICE_FLASH
    bool "Execute service instructions and constants from mapped flash"
    default y
    help
        Requires rebuilt service images. Banks are mapped read-only until all
        service tasks have stopped. Legacy RAM images are rejected in this mode.
config MICROS_SERVICE_DATA_BYTES
    int "Writable bytes reserved per service"
    range 256 4096
    default 1024 if MICROS_SERVICE_FLASH
    default 4096
    help
        Includes the ABI descriptor, initialized mutable data and BSS. Arenas
        and task stacks are budgeted separately. Rebuild services after changing.
endmenu
```

## src/firmware/platforms/esp8266/sdk/sdkconfig.defaults
```kconfig
CONFIG_ESPTOOLPY_FLASHMODE_DIO=y
CONFIG_ESPTOOLPY_FLASHFREQ_40M=y
CONFIG_ESPTOOLPY_FLASHSIZE_4MB=y
CONFIG_ESP8266_XTAL_FREQ_26=y
CONFIG_COMPILER_OPTIMIZATION_LEVEL_RELEASE=y
CONFIG_PARTITION_TABLE_CUSTOM=y
CONFIG_PARTITION_TABLE_CUSTOM_FILENAME="partitions.csv"
CONFIG_FREERTOS_HZ=1000
CONFIG_ESP_CONSOLE_UART_BAUDRATE=115200
# Keep the existing SDK library default; shared protocol integers also work with nano.
# CONFIG_NEWLIB_NANO_FORMAT is not set
CONFIG_MBEDTLS_DYNAMIC_BUFFER=y
CONFIG_MBEDTLS_DYNAMIC_FREE_PEER_CERT=y
CONFIG_MBEDTLS_SSL_OUT_CONTENT_LEN=1024
CONFIG_MBEDTLS_SSL_IN_CONTENT_LEN=16384
CONFIG_MBEDTLS_HAVE_TIME_DATE=y

# CONFIG_MBEDTLS_CUSTOM_MEM_ALLOC is not set
```
